#include <ESP32Servo.h>

#define NUM_SERVOS 7
#define DO_MIN 1
#define DO_MAX 18
#define RE_MIN 19
#define RE_MAX 36
#define MI_MIN 37
#define MI_MAX 45
#define FA_MIN 46
#define FA_MAX 63
#define SOL_MIN 64
#define SOL_MAX 81
#define LA_MIN 82
#define LA_MAX 99
#define SI_MIN 100
#define SI_MAX 108

// Titanic
int melody[] = {41, 104, 42, 42, 42, 42, 104, 41, 102, 104, 41, 102, 42, 103, 41, 42, 104, 41, 86, 104, 40, 88, 42, 42, 40, 104, 41, 102, 104, 103, 102, 
  103, 41, 104, 42, 42, 42, 104, 102, 41, 104, 102, 41, 42, 103, 104, 103, 41, 86, 41, 40, 104, 88, 42, 104, 104, 41, 102, 41, 104, 103, 42, 102, 103, 42, 
  102, 101, 42, 102, 40, 41, 41, 41, 103, 41, 41, 103, 41, 40, 88, 41, 41, 40, 103, 103, 40, 40, 41, 103, 41, 40, 103, 41, 103, 41, 103, 41, 103, 41, 86, 
  103, 40, 88, 40, 88, 40, 40, 88, 88, 86, 40, 103, 41, 40, 90, 40, 86, 104, 42, 39, 41, 102, 40, 41, 41, 39, 40, 102, 40, 41, 42, 103, 103, 41, 42, 40, 
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  54, 54, 54, 56, 56, 52, 50, 52, 50, 7, 52, 52, 52, 7, 52, 52, 52, 70, 52, 72, 72, 72, 72, 54};

int bpm = 120;

Servo servos[NUM_SERVOS];
int pines[] = {22, 1, 2, 3, 4, 6, 7};
int open_pos[] = {150, 150, 150, 150, 150, 150, 150};
int close_pos[] = {90, 90, 90, 90, 90, 90, 90};

int number_of_notes;
int sleeptime;
int note;
int note_counter = 0;

void reeset_servos(void) {

  for (int i = 0; i < NUM_SERVOS; i++) {
    servos[i].write(close_pos[i]);
  }
}

void setup() {

  Serial.begin(9600);

  for (int i = 0; i < NUM_SERVOS; i++) {
    servos[i].attach(pines[i]);
  }

  note_counter = 0;
  number_of_notes = sizeof(melody) / sizeof(melody[0]);
  sleeptime = (60.0/bpm) * 1000;
  Serial.println(sleeptime);
}

void loop() {
  
  while (note_counter < number_of_notes) {
    
    reeset_servos();
    note = melody[note_counter];

    if (DO_MIN <= note && note <= DO_MAX)
      servos[0].write(open_pos[0]);
    if (RE_MIN <= note && note <= RE_MAX)
      servos[1].write(open_pos[1]);
    if (MI_MIN <= note && note <= MI_MAX)
      servos[2].write(open_pos[2]);
    if (FA_MIN <= note && note <= FA_MAX)
      servos[3].write(open_pos[3]);
    if (SOL_MIN <= note && note <= SOL_MAX)
      servos[4].write(open_pos[4]);
    if (LA_MIN <= note && note <= LA_MAX)
      servos[5].write(open_pos[5]);
    if (SI_MIN <= note && note <= SI_MAX)
      servos[6].write(open_pos[6]);

    sleep(sleeptime);
    note_counter ++;
  }
}